## config/west.yml
```yaml
manifest:
  remotes:
    - name: zmkfirmware
      url-base: https://github.com/zmkfirmware
    - name: badjeff
      url-base: https://github.com/badjeff/
    - name: efogdev
      url-base: https://github.com/efogdev
    - name: oleksandrmaslov
      url-base: https://github.com/oleksandrmaslov
    - name: carrefinho
      url-base: https://github.com/carrefinho  

  projects:
    - name: zmk
      remote: zmkfirmware
      revision: v0.3
      import: app/west.yml
    - name: zmk-pmw3610-driver
      remote: efogdev
      revision: main
    - name: zmk-input-processor-report-rate-limit
      remote: badjeff
      revision: main
    - name: zmk-input-processor-xyz
      remote: badjeff
      revision: main
    - name: zmk-pointing-acceleration
      remote: oleksandrmaslov
      revision: main
    - name: prospector-zmk-module
      remote: carrefinho
      revision: main

  self:
    path: config
```

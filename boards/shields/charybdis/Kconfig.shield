## boards/shields/charybdis/Kconfig.shield
```kconfig
# No whitespace after the comma or in your part name!

config SHIELD_COSMOS_LEFT
    def_bool $(shields_list_contains,cosmos_left)

config SHIELD_COSMOS_RIGHT
    def_bool $(shields_list_contains,cosmos_right)

config SHIELD_COSMOS_DONGLE
	def_bool $(shields_list_contains,cosmos_dongle)
```

## boards/shields/cosmos/Kconfig.defconfig
```kconfig
if SHIELD_COSMOS_DONGLE

config ZMK_KEYBOARD_NAME
	default "Kai Cosmos"

config ZMK_SPLIT_ROLE_CENTRAL
	default y

endif

if SHIELD_COSMOS_DONGLE || SHIELD_COSMOS_LEFT || SHIELD_COSMOS_RIGHT

config ZMK_POINTING
    default y

config ZMK_SPLIT
	default y
	
endif

if SHIELD_COSMOS_RIGHT

config SPI
    default y

endif
```

## boards/shields/kai_cosmos/Kconfig.defconfig
```kconfig
if SHIELD_COSMOS_DONGLE

config ZMK_KEYBOARD_NAME
    default "Kai Cosmos"

config ZMK_SPLIT_ROLE_CENTRAL
    default y

config ZMK_SPLIT
    default y

# Set this to the number of peripherals your dongle will have.
# For a unibody, this would be 1. If you have left and right halves, set it to 2, etc.
config ZMK_SPLIT_BLE_CENTRAL_PERIPHERALS
    default 2

config ZMK_USB
	default y

endif

if SHIELD_COSMOS_LEFT || SHIELD_COSMOS_RIGHT || SHIELD_COSMOS_DONGLE

config ZMK_BLE
	default y

endif
```

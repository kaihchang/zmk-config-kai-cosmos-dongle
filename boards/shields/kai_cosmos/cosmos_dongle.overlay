#include "cosmos.dtsi"
#include <dt-bindings/zmk/matrix_transform.h>

#import "cosmos-layouts.dtsi"
&physical_layout0 {
    transform = <&default_transform>;
};

&glidepoint_listener {
    status = "okay";
};

/ {
    chosen {
        zmk,kscan = &mock_kscan;
        zmk,physical-layout = &physical_layout0;
    };

    mock_kscan: mock_kscan_0 {
        compatible = "zmk,kscan-mock";
        columns = <0>;
        rows = <0>;
        events = <0>;
    };
};
